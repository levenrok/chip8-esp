## components/graphics/Kconfig.projbuild
```kconfig
menu "Graphics Configuration"
    config I2C_PIN_SDA
        int "SDA pin GPIO number"
        default 21

    config I2C_PIN_SCL
        int "SCL pin GPIO number"
        default 22

    config I2C_HW_ADDRESS
        hex "I2C device hardware address"
        default 0x3C

    config I2C_CLK_SPEED_HZ
        int "I2C device clock speed in hertz"
        default 400000

    config DISPLAY_CMD_BITS
        int "Display's command bit number"
        default 8

    config DISPLAY_PARAM_BITS
        int "Display's parameter bit number"
        default 8

    config DISPLAY_H_RES
        int "Display's horizontal resolution"
        default 128

    config DISPLAY_V_RES
        int "Display's vertical resolution"
        default 64

endmenu
```

## main/Kconfig.projbuild
```kconfig
menu "Wi-Fi Configuration for the Server"
    config SERVER_WIFI_SSID
        string "Wi-Fi SSID"
        default "Espressif"
        help
            SSID (network name) of the Access Point for the server to connect to.

    config SERVER_WIFI_PASS
        string "Wi-Fi Password"
        default "Esp32"
        help
            WiFi password (WPA or WPA2) of the Access Point for the server to use.

    config SERVER_WIFI_MAXIMUM_RETRY
        int "Maximum Wi-Fi Retry Count"
        default 7
        help
            Set the Maximum retry to avoid station reconnecting to the AP unlimited when the AP is really inexistent.
endmenu
```
